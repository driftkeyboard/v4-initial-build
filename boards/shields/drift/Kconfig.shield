## boards/shields/drift/Kconfig.shield
```kconfig
config SHIELD_drift_LEFT
    def_bool $(shields_list_contains,drift_left)

config SHIELD_drift_RIGHT
    def_bool $(shields_list_contains,drift_right)

config SHIELD_DRIFT_CENTRAL_DONGLE
    def_bool $(shields_list_contains,drift_central_dongle)

config SHIELD_DRIFT_PERIPHERAL_LEFT
    def_bool $(shields_list_contains,drift_peripheral_left)
```
